#include<P18F452.INC>

ORG 0X00
GOTO INICIO

ORG 0X08
RETFIE

ORG 0X18
RETFIE

INICIO		BSF		TRISB, 2		;RB2 ENTRADA
			CLRF	TRISD			;PORTD SAНDA
		
BOTAO		BTFSC	PORTB, 2 		;SE FOR 0 CALL DEBOUNCE SENAO FICA NO BOTAO
			GOTO	BOTAO
			CALL	DEBOUNCE
			BTFSC	PORTB, 2		;VALIDA MAIS UMA VEZ SE O BOTAO AINDA ESTA PRESSIONADO SE TIVER CHAMA INCREMENTA SENAO VAI PRO BOTAO
			GOTO	BOTAO			
INCREMENTA	INCF	LATD, F			;INCREMENTA 1
PRESO		BTFSS	PORTB, 2		;VALIDA SE FOR 0 OU SEJA O BOTAO AINDA ESTA PRESSIONADO FICA NO PRESO, SENAO (BOTAO SOLTO EM 0)CHAMA BOTAO
			GOTO	PRESO
			GOTO	BOTAO
DEBOUNCE	MOVLW	.100			;MOVE LITETAL 100 PRA W
			MOVWF	0X80			;MOVE CONTEUDO DE W PRA POSICAO DE MEMORIA 0X80

LOOP2		MOVLW	.250			;MOVE LITERAL 250 PRA W
			MOVWF	0X81			;MOVE CONTEUDO DE W PARA POSICAO DE MEMORIA 0X81
LOOP1		NOP						;GASTA UM CICLO
			DECFSZ	0X81, F			;DECREMENTA 1 DO 250 (0X81)
			GOTO	LOOP1
			DECFSZ	0X80, F			;DECREMENTA 1 DO 100 (0X80)
			GOTO	LOOP2
			RETURN					;VOLTA PRO PROGRAMA
			


		

END
